#include "OLED.h"
#include "i2c.h"
#include "stm32f1xx_hal.h"
#include <stdint.h>
#include <string.h>

#define SSD1315_Address                     0x78
#define Command_MemAddress                  0x00
#define Data_MemAddress                     0x40
#define ABS(x) ((x) > 0 ? (x) : -(x))
#define MIN(a, b)  (((a) < (b)) ? (a) : (b))

const uint8_t ANSIFont68[][6]={
    {0x00, 0x00, 0x00, 0x00, 0x00, 0x00}, // Space (32)
    {0x00, 0x00, 0x5F, 0x00, 0x00, 0x00}, // ! (33)
    {0x00, 0x07, 0x00, 0x07, 0x00, 0x00}, // " (34)
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    {0x00, 0x00, 0x00, 0x00, 0x00, 0x00}, // DEL (127)
};
const uint8_t ANSIFont816[][16] = {
    {0x00,0x00,0x00,0x00,0x00,0x00,0x00,0x00,0x00,0x00,0x00,0x00,0x00,0x00,0x00,0x00},// sp (0x20)
    {0x00,0x00,0x18,0x3C,0x3C,0x3C,0x18,0x18,0x18,0x00,0x18,0x18,0x00,0x00,0x00,0x00},// !
    {0x00,0x66,0x66,0x66,0x24,0x00,0x00,0x00,0x00,0x00,0x00,0x00,0x00,0x00,0x00,0x00},// "
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    {0x00,0x00,0x00,0x00,0x31,0x4A,0x04,0x00,0x00,0x00,0x00,0x00,0x00,0x00,0x00,0x00},// ~
};

uint8_t Background_GRAM[8][128];
uint8_t GRAM[8][128];

void SSD1315_WriteCommand(uint8_t Command){
    uint8_t pData[1];
    pData[0]=Command;
    HAL_I2C_Mem_Write(&hi2c1, SSD1315_Address, Command_MemAddress, I2C_MEMADD_SIZE_8BIT, pData, 1, 100);
}

void SSD1315_WriteData(uint8_t* pData){
    HAL_I2C_Mem_Write(&hi2c1, SSD1315_Address , Data_MemAddress, I2C_MEMADD_SIZE_8BIT, pData,128, 100);
}

void SSD1315_Clear(void){
    memset(Background_GRAM, 0, sizeof(Background_GRAM));
    memset(GRAM, 0, sizeof(GRAM));
    for (uint8_t i=0; i<8; i++) {
        SSD1315_WriteCommand(0xB0+i);
        SSD1315_WriteCommand(0x00);
        SSD1315_WriteCommand(0x10);  //set the start addresss
    }
}

void SSD1315_Init(void) {
    // 1. 等待硬件稳定（可选，视电源情况加几毫秒延迟）
    // Delay_ms(100); 

    // 2. 关闭显示（防止初始化过程中的杂波）
    SSD1315_WriteCommand(0xAE); 

    // 3. 设置时钟分频因子, 震荡频率
    SSD1315_WriteCommand(0xD5); 
    SSD1315_WriteCommand(0x80); // 默认建议值

    // 4. 设置驱动路数 (128x64分辨率为63)
    SSD1315_WriteCommand(0xA8); 
    SSD1315_WriteCommand(0x3F); 

    // 5. 设置显示偏移
    SSD1315_WriteCommand(0xD3); 
    SSD1315_WriteCommand(0x00); 

    // 6. 设置显示开始行
    SSD1315_WriteCommand(0x40); 

    // 7. 【关键】设置电荷泵（必须开启，否则屏幕不亮）
    SSD1315_WriteCommand(0x8D); 
    SSD1315_WriteCommand(0x14); // 开启内部升压

    // 8. 设置内存地址模式 (0x02为页寻址模式)
    SSD1315_WriteCommand(0x20); 
    SSD1315_WriteCommand(0x02); 

    // 9. 设置段/列映射 (0xA1 为正常, 0xA0 为左右反转)
    SSD1315_WriteCommand(0xA1); 

    // 10. 设置行输出扫描方向 (0xC8 为正常, 0xC0 为上下反转)
    SSD1315_WriteCommand(0xC8); 

    // 11. 设置COM引脚硬件配置
    SSD1315_WriteCommand(0xDA); 
    SSD1315_WriteCommand(0x12); 

    // 12. 设置对比度 (亮度控制)
    SSD1315_WriteCommand(0x81); 
    SSD1315_WriteCommand(0xCF); // 值越大越亮

    // 13. 设置预充电周期
    SSD1315_WriteCommand(0xD9); 
    SSD1315_WriteCommand(0xF1); 

    // 14. 设置 VCOMH 保持电压
    SSD1315_WriteCommand(0xDB); 
    SSD1315_WriteCommand(0x40); 

    // 15. 全局显示开启 (0xA4正常显示, 0xA5全屏像素点亮)
    SSD1315_WriteCommand(0xA4); 

    // 16. 设置正常显示 (0xA6正常, 0xA7反相)
    SSD1315_WriteCommand(0xA6); 

    // 17. 开启屏幕
    SSD1315_WriteCommand(0xAF); 
    
    // 18. 清屏（建议初始化后立即清除显存，否则可能显示出随机乱码）
    SSD1315_Clear(); 
}

void SSD1315_Update(void){
    for (uint8_t i=0; i<8; i++) {
        SSD1315_WriteCommand(0xB0+i);
        SSD1315_WriteCommand(0x00);
        SSD1315_WriteCommand(0x10);  //set the start addresss
        SSD1315_WriteData(GRAM[i]);
    }
}

void SSD1315_DrawPixel(uint8_t X,uint8_t Y,Color Pixel_Color){
    if (X > 127 || Y > 63) return; //防越界
    uint8_t Page,Colum,Byte;
    Page = Y/8;
    Colum=X;
    if (Pixel_Color==White) {
        Byte=0x01<<(Y%8);
        GRAM[Page][Colum]|=Byte;
        Background_GRAM[Page][Colum]|=Byte;      //数据备份
    }
    else if (Pixel_Color==Black) {
        Byte=~(0x01<<(Y%8));
        GRAM[Page][Colum]&=Byte;
        Background_GRAM[Page][Colum]&=Byte;     //数据备份
    }     
}

void SSD1315_ReversePixel(uint8_t Buf[8][128], uint8_t X,uint8_t Y){
    if (X > 127 || Y > 63) return; //防越界
    uint8_t Page,Colum;
    Page = Y/8;
    Colum=X;
    if (Buf[Page][Colum]&(0x01<<(Y%8))) {
        Buf[Page][Colum]&=~(0x01<<(Y%8));
    }
    else{
        Buf[Page][Colum]|=0x01<<(Y%8);
    }
}

void SSD1315_DrawRectangle(Rectangle_TypeDef* Rectangle){
    uint8_t i,a;
    if (Rectangle->Color==White) {
        for (i=0; i<Rectangle->Size.Length; i++) {
            for (a=0; a<Rectangle->Size.Width; a++) {
                SSD1315_DrawPixel(Rectangle->Location.X+a, Rectangle->Location.Y+i,White);
            }//full
        }
    }
    if (Rectangle->Color==Black) {
        for (i=0; i<Rectangle->Size.Length; i++) {
           
                if (i==0||i==Rectangle->Size.Length-1) {
                        for (a=0; a<Rectangle->Size.Width+1; a++) {
                        SSD1315_DrawPixel(Rectangle->Location.X+a, Rectangle->Location.Y+i,White);
                        }
                }  //上下边框
                else {
                    SSD1315_DrawPixel(Rectangle->Location.X,Rectangle->Location.Y+i,White);
                    SSD1315_DrawPixel(Rectangle->Location.X+Rectangle->Size.Width,Rectangle->Location.Y+i,White);
                }  //左右边框
            //box
        }
    }
}//绘制一个实心或者空心的矩形,影响背景

void SSD1315_InvertRectangle(Rectangle_TypeDef* Rectangle){
    uint8_t i,a;
    memcpy(GRAM,Background_GRAM,sizeof(GRAM));      //把GRAM擦干净
    if (Rectangle->Color==White) {
        for (i=0; i<Rectangle->Size.Length; i++) {
            for (a=0; a<Rectangle->Size.Width; a++) {
                SSD1315_ReversePixel(GRAM,Rectangle->Location.X+a, Rectangle->Location.Y+i);
            }//full
        }
    }
    if (Rectangle->Color==Black) {
        for (i=0; i<Rectangle->Size.Length; i++) {
           
                if (i==0||i==Rectangle->Size.Length-1) {
                        for (a=0; a<Rectangle->Size.Width+1; a++) {
                        SSD1315_ReversePixel(GRAM,Rectangle->Location.X+a, Rectangle->Location.Y+i);
                        }
                }  //上下边框
                else {
                    SSD1315_ReversePixel(GRAM,Rectangle->Location.X,Rectangle->Location.Y+i);
                    SSD1315_ReversePixel(GRAM,Rectangle->Location.X+Rectangle->Size.Width,Rectangle->Location.Y+i);
                }  //左右边框
            //box
        }
    }
}//绘制一个实心或者空心的矩形，通过双缓不影响背景,该函数仅仅用于绘制复选框，该设计会导致屏幕上只能有一个框

void SSD1315_CleanDrawRectangle(Rectangle_TypeDef* Rectangle){
    SSD1315_InvertRectangle(Rectangle);
    memcpy(Background_GRAM, GRAM, sizeof(GRAM));
}//不影响背景的画固定框，解决了SSD1315_InvertRectangle无法修改背景的问题


void SSD1315_ShowChar(uint8_t X,uint8_t Y,uint8_t Char,uint8_t Size,Color Color){
    if (Size==1) {
        for (uint8_t i=0; i<6; i++) {
            for (uint8_t a=0; a<8; a++) {
                if (ANSIFont68[Char-32][i]&(0x01)<<a) {
                    SSD1315_DrawPixel(X+i, Y+a, Color);
                }
            }
        }
    }else if (Size == 2) { // 8x16 (横向取模，最通用的 816 格式，注意，这和上面的是两种绘制方式
        for (uint8_t i = 0; i < 16; i++) { 
            for (uint8_t a = 0; a < 8; a++) { 
                if (ANSIFont816[Char-32][i]&(0x80)>>a) {
                    SSD1315_DrawPixel(X+a, Y+i, Color);
                }
            }
        }
    }
}

void SSD1315_ShowString(uint8_t X,uint8_t Y,const char* String,uint8_t Size,Color Color){
    while(*String != '\0'){
        SSD1315_ShowChar(X, Y, *String, Size,Color);
        if(Size == 1)      X += 6;  // 6x8 字体
        else if(Size == 2) X += 8;  // 8x16 字体
        String++;
    }
}

void SSD1315_ShowNumber(uint8_t X,uint8_t Y,uint8_t Number,uint8_t Size,uint8_t Color){       //此函数有一定局限性，只能显示两位，但是够用
    char str[3];
    str[0]='0'+(Number/10);
    str[1]='0'+(Number%10);
    str[2]='\0';
    SSD1315_ShowString(X,Y,str,Size,Color);
}


